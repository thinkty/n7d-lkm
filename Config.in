## Config.in
```kconfig
config BR2_PACKAGE_N7D
	bool "n7d"
	depends on BR2_LINUX_KERNEL
	help
		Numerical 7-segment display device driver for linux
		
		https://github.com/thinkty/n7d-lkm.git

comment "n7d needs toolchain w/ headers >= 5.15, and a Linux kernel to be built"
	depends on !BR2_LINUX_KERNEL
```
